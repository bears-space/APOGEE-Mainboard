## main/Kconfig.projbuild
```kconfig
menu "Example Configuration"

    config EXAMPLE_BASIC_AUTH
        bool "Basic Authentication"
        default n
        help
            Basic Authentication is a method for an HTTP user agent (e.g. a web browser)
            to provide a user name and password when making a request. It is the simplest
            technique for enforcing access controls to web resources. because it doesn't
            require cookies, session identifiers, or login pages; rather, it uses standard
            fields in the HTTP header.
            Note that, Basic Authentication is not encrypted channel and also easy to retrieve
            credentials as they are sent in plain text format.

    config EXAMPLE_BASIC_AUTH_USERNAME
        string "Basic Authenticate User Name"
        depends on EXAMPLE_BASIC_AUTH
        default "ESP32"
        help
            The client's user name which used for basic authenticate.

    config EXAMPLE_BASIC_AUTH_PASSWORD
        string "Basic Authenticate Password"
        depends on EXAMPLE_BASIC_AUTH
        default "ESP32Webserver"
        help
            The client's password which used for basic authenticate.

    config EXAMPLE_ENABLE_SSE_HANDLER
        bool "Enable Server-Sent Events (SSE) handler"
        default n
        help
            Enable this option to use Server-Sent Events (SSE) functionality.
            This will allow the server to push real-time updates to the client over an HTTP connection.

endmenu

menu "Vigilant Engine Configuration"

    config VE_ENABLE_STATUS_LED
        bool "Enable Status LED"
        default y
        help
            Enable this option to use the status LED functionality in Vigilant Engine.
            The status LED provides visual feedback on the system's status and operations, and can optionally be used for visual output.
    config VE_STATUS_LED_GPIO
        int "Status LED GPIO pin"
        default 8
        help
            The GPIO pin number for the status LED.
        
endmenu
```

## sdkconfig.defaults
```kconfig
CONFIG_PARTITION_TABLE_CUSTOM=y
CONFIG_PARTITION_TABLE_CUSTOM_FILENAME="main/partitions.csv"

# Rollback (für kaputte OTA Updates)
CONFIG_BOOTLOADER_APP_ROLLBACK_ENABLE=y

# “Hold GPIO to force Recovery”
CONFIG_BOOTLOADER_FACTORY_RESET=y
CONFIG_BOOTLOADER_OTA_DATA_ERASE=y
# GPIO musst du wählen (siehe unten)
# CONFIG_BOOTLOADER_NUM_PIN_FACTORY_RESET=9
# CONFIG_BOOTLOADER_HOLD_TIME_GPIO=5
```
