## components/fan/Kconfig
```kconfig
menu "Fan Configuration"

    config FAN_PIN
        int "Fan GPIO"
        range 0 64
        default 47
        help
            GPIO pin used to control the fan.

    config PCNT_PIN
        int "Pulse Counter GPIO"
        range 0 64
        default 48
        help
            GPIO pin used to read the fan's pulse counter.

endmenu
```
